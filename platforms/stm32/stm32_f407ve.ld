/* STM32F407xE / APM32F407xE: 512 KB flash, 64 KB CCM, 128 KB SRAM1+SRAM2 */

MEMORY
{
    FLASH (rx)  : ORIGIN = 0x08000000, LENGTH = 512K
    CCM   (rw)  : ORIGIN = 0x10000000, LENGTH = 64K
    SRAM  (rwx) : ORIGIN = 0x20000000, LENGTH = 128K
}

REGION_ALIAS("CORE_RAM", CCM);
REGION_ALIAS("BULK_RAM", SRAM);

PROVIDE(_stack_size = 16K);

INCLUDE stm32_common.ld

/* STM32F746xG: 1 MB flash, 64 KB DTCM, 256 KB SRAM1+SRAM2 */

MEMORY
{
    FLASH (rx)  : ORIGIN = 0x08000000, LENGTH = 1M
    DTCM  (rwx) : ORIGIN = 0x20000000, LENGTH = 64K
    SRAM  (rwx) : ORIGIN = 0x20010000, LENGTH = 256K
}

REGION_ALIAS("CORE_RAM", DTCM);
REGION_ALIAS("BULK_RAM", SRAM);

PROVIDE(_stack_size = 16K);

INCLUDE stm32_common.ld
